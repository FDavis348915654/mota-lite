## mota-lite-esp32/sdkconfig.defaults
```kconfig
# ESP32-S3 + 16MB Flash + 8MB OCT PSRAM
CONFIG_IDF_TARGET="esp32s3"

CONFIG_ESPTOOLPY_FLASHSIZE_16MB=y
CONFIG_ESPTOOLPY_FLASHMODE_QIO=y
CONFIG_ESPTOOLPY_FLASHFREQ_80M=y

# PSRAM：帧缓冲 450KB 与 QuickJS 堆都要靠它
CONFIG_SPIRAM=y
CONFIG_SPIRAM_MODE_OCT=y
CONFIG_SPIRAM_SPEED_80M=y
CONFIG_SPIRAM_USE_MALLOC=y
CONFIG_SPIRAM_MALLOC_ALWAYSINTERNAL=8192

CONFIG_PARTITION_TABLE_CUSTOM=y
CONFIG_PARTITION_TABLE_CUSTOM_FILENAME="partitions.csv"

# QuickJS 的 eval 与 C 侧调用都吃栈，主任务给足
CONFIG_ESP_MAIN_TASK_STACK_SIZE=16384
CONFIG_FREERTOS_HZ=1000

CONFIG_COMPILER_OPTIMIZATION_PERF=y
CONFIG_LOG_DEFAULT_LEVEL_INFO=y

# 二进制体积不是问题，保留符号便于看 backtrace
CONFIG_ESP_SYSTEM_PANIC_PRINT_REBOOT=y
```
